// https://github.com/OlegRubtsov/Auto-Start-Engine
// версия 2021-04-27

// Автозапуск авто на arduino и модеме m590e
// запуск возможен двойным звонком на номер сим карты, оба звонка должны быть сделаны на 30 секунд
// если двигатель запущен, то одиночный звонок продлит время работы
// All commands:  - перечень СМС
// Start          - запуск
// Stop           - остановка
// Balance        - баланс встроенной сим карты
// Info           - краткая информация о системе (статус, напряжение, температура...)
// List           - перечень прописанных телефонов
// P0 79001122331 - 
// P1 79001122332 - 
// P2 79001122333 - установка прописанных номеров, максимум 3 штуки, формат СМС "P0 7900xxxxxxx" или "P1 7900xxxxxxx" или "P2 7900xxxxxxx",
//                  в рамках безопасности это может сделать или уже авторизованный номер,  
//                  или при нажатом тормозе и выключенном двигателе (подразумевается что действие производит владелец изнутри авто) 
// SmsON          - включение уведомления о запуске, остальное смысловое общение, естественно через СМС
// SmsOFF         - выключение уведомления о запуске
// Factory        - сброс на типовые настройки (FactoryReset)
// Time 0..30     - время прогрева от 1 до 30 минут, 0 - автоматический режим
// STms 0..5000   - время прокрутки стартера (в микросекундах) от 1 до 3000 микросекунд, 0 - автоматический режим
// Help           - перечень команд

#include <SoftwareSerial.h>
#include <EEPROM.h>
#include <OneWire.h>

// АППАРАТНАЯ КОНФИГУРАЦИЯ (ПОРТЫ)
#define PORT_STARTER 9                              // d9 реле стартера
#define PORT_SECONDPOWER 10                            // d10 реле цепи вторичного питания печка, фары и т.д.
#define PORT_ENGINE 11                              // d11 реле зажигания
#define PORT_IMMO 12                                // d12 реле обходчика иммобилайзера
//#define PORT_BUZZER 5                             // d5 пищалка (для тестов)
#define PORT_LED_STATUS 13                          // d13 светодиод (для тестов)
#define PORT_MODEM_BOOT 17                          // порт A3 (или 17) управление модемом, инверсия через транзитор
#define PORT_MODEM_TX 2                             // TXd модема = D2
#define PORT_MODEM_RX 3                             // RXd модема = D3 
#define PORT_INPUT_BATTERY A0                       // порт АЦП А0 (или 14) для контроля питания авто
#define PORT_INPUT_DS18B20 A1                       // порт А1 (или 15) для датчика температуры
#define PORT_INPUT_STOP A4                          // порт АЦП A4 (или 18) педаль тормоза
#define PORT_INPUT_ENGINE A5                        // порт АЦП А5 (или 19) для контроля включения зажигания (обратная связь)
#define PORT_INPUT_HANDBRAKE A6                     // порт АЦП A6 (или ___) датчик активации ручного тормоза (ручника)


// GSM команды, возможно различие между операторами
#define BALANCE_COMMAND "ATD#100#"                  // Команда запроса баланса. Для МТС-МСК выдает в ответ строчку Balance:123.45r
#define COUNT_PHONE 3                               // Максимальное колличество телефонных номеров (от 1 до 16)

#define EWT_MAX 30                                  // Максимальное количество минут прогрева (через СМС меняется от 0 до этого значения)
#define ST_MIN 1000                                 // Минимальное время прокрутки стартера, миллисекунды
#define ST_MAX 5000                                 // Максимальное время прокрутки стартера, миллисекунды

// СИСТЕМНЫЕ ПАРАМЕТРЫ (менять не желательно)
// Конфигурация EEPROM адресов
#define EEPROM_ADDRES_sms_answer 10                 // хранение переменной sms_answer = СМС уведомления о запуске включены 
#define EEPROM_ADDRES_EWT 11                        // хранение переменной int engine_warm_time_setting EWT = время прогрева
#define EEPROM_ADDRES_STARTER 12                    // хранение переменной int starter_time_setting, время работы стартера
#define EEPROM_ADDRES_MASTER0 20                    // masterPhone 0 (начиная с этого адреса храним телефонные номера)
// Константы
const int DELAY_TO_WAITING_2ND_RING = 30000;        // Задержка ожидания 2го звонка для запуска = 30 000 миллисекунд
const int DELAY_BEFORE_DETECTING_START = 6000;      // Столько миллисекунд ждем перед детекцией запуска по напряжению 
// Блок вольтметра (вольтметр для определения факта запуска авто) 
const float VBATT_LOW = 10.0;                       // низкий уровень заряда батареи (аккумулятора) 
const float U1_START = 13.4;                        // Напряжение зарядки АКБ (Двигатель запущен, генератор работает). 
const int MEASURE_COUNT = 10;                       // циклов периода измерения напряжения батареи (среднее значение из N измерений)
                                                    // Формула u1=avarageU1/MEASURE_RATIO*5/1024/R2*(R1+R2), итоговый коэффициент = 5/1024/R2*(R1+R2)=0.022414801
const float MEASURE_RATIO = 0.022415;               // коэффициент (максимально точно измерить для делителя напряжения идущего к аккумулятору авто, 
                                                    // остальные не так важны, главное поставить похожие по номиналам резисторы в делителе
                   
// Настройки, изменяемые посредством СМС 
int engine_warm_time_setting = 10;                  // время работы мотора после запуска 10 минут 
int starter_time_setting = 1000;                    // мс. прокрутки стартера
boolean sms_answer = 0;                             // СМС 0-выключены, 1-включены

// Переменные статуса автозапуска
int engine_warm_time_local = 10;                    // время работы мотора после запуска 10 минут 
int starter_time_local = 1000;                      // мс. прокрутки стартера
int engine_is_started = 0;                          // 0 - двигатель выключен, 1 - двигатель включен 
int left_start_try = 0;                             // переменная для хранения остатка числа попыток запуска 
unsigned long last_start_time = 0;                  // время запуска (когда был запущен) двигатель в миллисекундах 

// Настройки GSM 
SoftwareSerial gsm(PORT_MODEM_TX, PORT_MODEM_RX); 
int ring_counter = 0;                               // счетчик звонков, сбрасывается через время  DELAY_TO_WAITING_2ND_RING (Задержка ожидания 2го звонка) 
unsigned long ring_timer = 0;
int modem_on = 0;                                   // переменная статуса включения модема
char  masterPhone[COUNT_PHONE][12];                 // мастер номера с которых принимаются команды, задаются по СМС, значения здесь не принципиальны
int index_master = 255;                             // индекс номера мастер телефона от которого отправлена команда
int index_master_to_late_answer = 255;              // кому отправляем СМС (индекс массива), если отправка происходит не на текущем шаге программы (Баланс)
String buf = "";
// Датчик температуры
OneWire  ds(PORT_INPUT_DS18B20);                    // on pin 10 (необходим резистор 4,7 кОм)

//==================================================================================================================================================================
void setup() {
  Serial.begin(9600);                                //скорость порта
  //eepromFactoryReset();
  EEPROMReadSettings();
  gsm.begin(9600); //скорость порта модема
  pinMode(PORT_MODEM_BOOT, OUTPUT);           // порт управления загрузкой модема
  
  // Настройка портов   
  pinMode(PORT_STARTER, OUTPUT);                //стартер
  digitalWrite(PORT_STARTER, LOW);              //выкл.
 
  pinMode(PORT_ENGINE, OUTPUT);                 //зажигание
  digitalWrite(PORT_ENGINE, LOW);               //выкл.
 
  pinMode(PORT_SECONDPOWER, OUTPUT);               //вторичные цепи
  digitalWrite(PORT_SECONDPOWER, LOW);             //выкл. 

  //pinMode(PORT_BUZZER, OUTPUT);               //пищалка
  //digitalWrite(PORT_BUZZER, LOW);             //выкл.
 
  pinMode(PORT_IMMO, OUTPUT);                   //реле обходчика иммобилайзера
  digitalWrite(PORT_IMMO, LOW);                 //выкл. 

  pinMode(PORT_INPUT_BATTERY, INPUT);           // порт контроля заряда АКБ
  pinMode(PORT_INPUT_STOP, INPUT);              // порт контроля педали тормоза
  pinMode(PORT_INPUT_HANDBRAKE, INPUT);         // порт контроля ручного тормоза (ручника)
  pinMode(PORT_INPUT_ENGINE, INPUT);            // порт контроля включенного зажигания для блокировки автозапуска при уже включенном зажигании

SetModem(1);                                    //Запуск модема
//MsTimer2::set(100, timerInterupt);            // прерывания по таймеру, период 100 мс 
//MsTimer2::start();                            // разрешение прерывания
//left_start_try=3;                             // ТЕСТ сразу производится запуск
}
//==================================================================================================================================================================
void loop() {
CheckGSMcommand();
if ( DetectStop()) Do_shutdown();                                           // если был нажат тормоз отключаем автозапуск (обеспечение безопасности)
// код программы автозапуска
if (engine_is_started) {                                                    // ждем окончания прогрева
    if (VBatt() < U1_START) Do_shutdown();                                  // проверяем что двиuгатель не заглох, если заглох, то все выключаем
    if (millis() < last_start_time) last_start_time = 0;                    // контроль сброса счетчика millis, милисекунды обнуляются каждые 49 суток
    if (millis() > last_start_time + engine_warm_time_local*60000)          // если текущее время больше чем время старта + время прогрева
        Do_shutdown();   
    }
else { //если двигатель не запущен проверяем возможность запуска - ЭТО:
      // 1. есть неиспользованные попытки, 
      // 2. генератор не работает, 
      // 3. зажигание не включено ключом
  if (!DetectEngine() && VBatt()>VBATT_LOW && left_start_try>0 && VBatt()<U1_START) 
  Do_start();                                                               // запускаем двигатель 
  else Do_shutdown();                                                       // если генератор работает = двигатель запущен, то отменяем автозапуск
  }
}

//========================================================================================================================================================
void timerInterupt() {  // обработка прерывания 1 мс
//if (DetectStop()) flag_stop_pressed = HIGH;// обработка нажатия педали СТОП
}
